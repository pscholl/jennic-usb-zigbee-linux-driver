## drivers/ieee80215/Kconfig
```kconfig
menuconfig IEEE802154_DRIVERS
	bool "IEEE 802.15.4 drivers"
	depends on NETDEVICES && IEEE802154
	default y
	---help---
	  Say Y here to get to see options for IEEE 802.15.4 Low-Rate
	  Wireless Personal Area Network device drivers. This option alone
	  does not add any kernel code.

	  If you say N, all options in this submenu will be skipped and disabled.

if IEEE802154_DRIVERS && NETDEVICES && IEEE802154
config IEEE802154_FAKELB
	tristate "Fake LR-WPAN driver with several interconnected devices"
	---help---
	  Say Y here to enable the fake driver that can emulate a net
          of several interconnected radio devices.

          This driver can also be built as a module. To do so say M here.
	  The module will be called 'fakelb'.

config IEEE802154_SERIAL
	tristate "Simple LR-WPAN UART driver"

endif
```

## net/mac802154/Kconfig
```kconfig
config MAC802154
	tristate "Generic IEEE 802.15.4 Soft Networking Stack (mac802154)"
	depends on IEEE802154 && EXPERIMENTAL
	select CRC_ITU_T
	---help---
	  This option enables the hardware independent IEEE 802.15.4
	  networking stack for SoftMAC devices (the ones implementing
	  only PHY level of IEEE 802.15.4 standard).

	  Note: this implementation is neither certified, nor feature
	  complete! We do not garantee that it is compatible w/ other
	  implementations, etc.

	  If you plan to use HardMAC IEEE 802.15.4 devices, you can
          say N here. Alternatievly you can say M to compile it as
	  module.
```

## net/zigbee/Kconfig
```kconfig
config ZIGBEE 
	tristate "ZigBee Low-Rate Wireless Personal Area Networks support (EXPERIMENTAL)"
	depends on EXPERIMENTAL && BROKEN
	---help---
	  
	Say Y here to compile ZigBee support into the kernel or say M to
	  compile it as modules.
```
